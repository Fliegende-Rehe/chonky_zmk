#include <dt-bindings/zmk/matrix_transform.h>
#include "lil_curvy_bois.dtsi"

&default_transform {
    col-offset = <5>;
};

// &kscan0 {
//        col-gpios
//             = <&gpio0 17 GPIO_ACTIVE_HIGH>
//             , <&gpio0 20 GPIO_ACTIVE_HIGH>
//             , <&gpio0 22 GPIO_ACTIVE_HIGH>
//             , <&gpio0 24 GPIO_ACTIVE_HIGH>
//             , <&gpio1 00 GPIO_ACTIVE_HIGH>
//             ;
// };
&kscan0 {
    col-gpios
        = <&gpio0 31 GPIO_ACTIVE_HIGH>
        , <&gpio0 29 GPIO_ACTIVE_HIGH>
        , <&gpio0 02 GPIO_ACTIVE_HIGH>
        , <&gpio1 15 GPIO_ACTIVE_HIGH>
        , <&gpio1 13 GPIO_ACTIVE_HIGH>
        ;
};